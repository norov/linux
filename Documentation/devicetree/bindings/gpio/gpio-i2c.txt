## Documentation/devicetree/bindings/gpio/gpio-i2c.txt
```
Device-Tree bindings for gpio i2c driver

A simple parameterized no-irq of_driven i2c->gpio expander,
cut down from gpio-pcf857x.c to be totally device-tree driven.

Suitable for any "memory-like" device, where a 1-byte i2c read yields data
which can safely be written back, possibly with a bit changed, with the
effect of changing only the output level of that bit's GPIO pin.

Required properties:
	- compatible = "gpio-i2c"
	- reg = i2c-address
	- gpio-controller
	- #gpio-cells = <1>;
	- ngpios = number of pins modeled

Example nodes:

&i2c_bus {
        gpio1: cpld@6c {
                compatible = "gpio-i2c";
		gpio-controller;
                reg = <0x6c>;
		#gpio-cells = <1>;
                ngpios = <160>; // 8bits for each reg 0..0x13
        };
};

_some_device_ {
	// pin controlled by bitmask 0x2 of byte 0x4 of gpio1
	enable-gpios = <&gpio1 33>;
}
```

## Documentation/devicetree/bindings/mmc/octeon-mmc.txt
```
* Cavium Octeon & ThunderX MMC controller

The highspeed MMC host controller on Caviums SoCs provides an interface
for MMC and SD types of memory cards.

Supported maximum speeds are the ones of the eMMC standard 4.41 as well
as the speed of SD standard 4.0. Only 3.3 Volt is supported.

Required properties:
 - compatible : should be one of:
   * "cavium,octeon-6130-mmc"
   * "cavium,octeon-6130-mmc-slot"
   * "cavium,octeon-7890-mmc"
   * "cavium,octeon-7890-mmc-slot"
   * "cavium,thunder-8190-mmc"
   * "cavium,thunder-8190-mmc-slot"
   * "cavium,thunder-8390-mmc"
   * "cavium,thunder-8390-mmc-slot"
 - reg : mmc controller base registers
 - clocks : phandle

Optional properties:
 - for cd, bus-width and additional generic mmc parameters
   please refer to mmc.txt within this directory
 - "cavium,cmd-clk-skew" : number of coprocessor clocks before sampling command
 - "cavium,dat-clk-skew" : number of coprocessor clocks before sampling data

Deprecated properties:
- spi-max-frequency : use max-frequency instead
- "cavium,bus-max-width" : use bus-width instead

Examples:
	- Within .dtsi:
	mmc_1_4: mmc@1,4 {
		compatible = "cavium,thunder-8390-mmc";
		reg = <0x0c00 0 0 0 0>;	/* DEVFN = 0x0c (1:4) */
		#address-cells = <1>;
		#size-cells = <0>;
		clocks = <&sclk>;
	};

	- Within dts:
	mmc-slot@0 {
		compatible = "cavium,thunder-8390-mmc-slot";
		reg = <0>;
		voltage-ranges = <3300 3300>;
		max-frequency = <42000000>;
		bus-width = <4>;
		cap-sd-highspeed;
	};
	mmc-slot@1 {
		compatible = "cavium,thunder-8390-mmc-slot";
		reg = <1>;
		voltage-ranges = <3300 3300>;
		max-frequency = <42000000>;
		bus-width = <8>;
		cap-mmc-highspeed;
		non-removable;
	};
```

## Documentation/devicetree/bindings/spi/spidev.txt
```
spidev: generic usermode SPI driver

The devicetree binding for devices interfaced through spidev
is controversial, and this documents a compromise for extensible
embedded systems, which is at variance with the kernel.org policy

By the policy discussed in kernel.org's commit 956b200a,
each new device type handled via the spidev device should be added
to spidev.c's signature list, because device tree entries should refer
to the actual hardware, not just an access method.

Changing the kernel to add compatible devices seems wrong,
but that's what the spidev code implied - logging a warning
if compatible="spidev" is listed in device-tree.

Two SPI-driven telephony devices (SLIC and framer) are added to
compatible-id list in the spirit of kernel.org's 956b200a.

In practice many distributions have found this to be unworkable,
and added a "linux,spidev" generic id, so that's added too,
to avoid having to rework generic thunder kernel when a new SPI
device is added, which can be managed from usermode by spidev.

One of these changes should go upstream, but perhaps not both,
so that devtree-described SPI targets can be accessed from
usermode via kernel spidev driver.

Perhaps the best solution is to mark device tree entries with both
the "linux,spidev" string, to allow binding to kernels without
knowledge of target device, and also with a target device string
to help usercode find the device type it's looking for.

Original list
        { .compatible = "rohm,dh2228fv" },
        { .compatible = "lineartechnology,ltc2488" },
added
        { .compatible = "silabs,si32260" },
        { .compatible = "maxim,ds26521" },
compromise for extendability
        { .compatible = "linux,spidev" },
```

## drivers/net/ethernet/cavium/Kconfig
```kconfig
#
# Cavium ethernet device configuration
#

config NET_VENDOR_CAVIUM
	bool "Cavium ethernet drivers"
	depends on PCI
	default y
	---help---
	  Select this option if you want enable Cavium network support.

	  If you have a Cavium SoC or network adapter, say Y.

if NET_VENDOR_CAVIUM

config THUNDER_NIC_PF
	tristate "Thunder Physical function driver"
	depends on 64BIT
	select THUNDER_NIC_BGX
	---help---
	  This driver supports Thunder's NIC physical function.
	  The NIC provides the controller and DMA engines to
	  move network traffic to/from the memory. The NIC
	  works closely with TNS, BGX and SerDes to implement the
	  functions replacing and virtualizing those of a typical
	  standalone PCIe NIC chip.

config THUNDER_NIC_VF
	tristate "Thunder Virtual function driver"
	select CAVIUM_PTP
	depends on 64BIT
	---help---
	  This driver supports Thunder's NIC virtual function

config	THUNDER_NIC_BGX
	tristate "Thunder MAC interface driver (BGX)"
	depends on 64BIT
	select PHYLIB
	select MDIO_THUNDER
	select THUNDER_NIC_RGX
	---help---
	  This driver supports programming and controlling of MAC
	  interface from NIC physical function driver.

config	THUNDER_NIC_RGX
	tristate "Thunder MAC interface driver (RGX)"
	depends on 64BIT
	select PHYLIB
	select MDIO_THUNDER
	---help---
	  This driver supports configuring XCV block of RGX interface
	  present on CN81XX chip.

config CAVIUM_PTP
	tristate "Cavium PTP coprocessor as PTP clock"
	depends on 64BIT
	depends on PTP_1588_CLOCK
	select CAVIUM_RST
	default y
	---help---
	  This driver adds support for the Precision Time Protocol Clocks and
	  Timestamping coprocessor (PTP) found on Cavium processors.
	  PTP provides timestamping mechanism that is suitable for use in IEEE 1588
	  Precision Time Protocol or other purposes.  Timestamps can be used in
	  BGX, TNS, GTI, and NIC blocks.

config LIQUIDIO
	tristate "Cavium LiquidIO support"
	depends on 64BIT
	imply PTP_1588_CLOCK
	select PTP_1588_CLOCK_CAVIUM_PTP
	select FW_LOADER
	select LIBCRC32C
	---help---
	  This driver supports Cavium LiquidIO Intelligent Server Adapters
	  based on CN66XX, CN68XX and CN23XX chips.

	  To compile this driver as a module, choose M here: the module
	  will be called liquidio.  This is recommended.

config OCTEON_MGMT_ETHERNET
	tristate "Octeon Management port ethernet driver (CN5XXX, CN6XXX)"
	depends on CAVIUM_OCTEON_SOC
	select PHYLIB
	select MDIO_OCTEON
	default y
	help
	  Enable the ethernet driver for the management
	  port on Cavium Networks' Octeon CN57XX, CN56XX, CN55XX,
	  CN54XX, CN52XX, and CN6XXX chips.

config LIQUIDIO_VF
	tristate "Cavium LiquidIO VF support"
	depends on 64BIT && PCI_MSI
	imply PTP_1588_CLOCK
	---help---
	  This driver supports Cavium LiquidIO Intelligent Server Adapter
	  based on CN23XX chips.

	  To compile this driver as a module, choose M here: The module
	  will be called liquidio_vf. MSI-X interrupt support is required
	  for this driver to work correctly

config OCTEONTX_FPA_PF
	tristate "OcteonTX free pool allocator physical function driver(FPA_PF)"
	depends on 64BIT
	default y
	help
	  Select this option to enable FPA Physical function.
          FPA provides hardware assisted memory management for
	  OcteonTX coprocessors.

config OCTEONTX_FPA_VF
	tristate "OcteonTX free pool allocator virtual function driver(FPA_VF)"
	depends on 64BIT
	default y
	help
	  Select this option to enable FPA Virtual function.
          FPA provides hardware assisted memory management for
	  OcteonTX coprocessors. Each VF owns single FPA pool.

config OCTEONTX_RST
	tristate "OcteonTX Reset driver(RST)"
	depends on 64BIT
	default y
	help
	  Select this option to enable RST.

config OCTEONTX_SSO_PF
	tristate "OcteonTX SSO physical function driver(SSO_PF)"
	depends on 64BIT && OCTEONTX_FPA_PF && OCTEONTX_FPA_VF && OCTEONTX_RST
	default y
	help
	  Select this option to enable SSO Physical function.
          SSO is a way to submit work from Cores.

config OCTEONTX_SSOW_PF
	tristate "OcteonTX SSOW physical function driver(SSOW_PF)"
	depends on 64BIT
	default y
	help
	  Select this option to enable SSOW Physical function.
          SSOW is a way to get work for cores.

config OCTEONTX_PKO_PF
	tristate "OcteonTX PKO physical function driver(PKO_PF)"
	depends on 64BIT
	default y
	help
	  Select this option to enable PKO Physical function.

config OCTEONTX_LBK
	tristate "OcteonTX Loopback Interface driver(LBK)"
	depends on 64BIT
	default y
	help
	  Select this option to enable LBK.

config OCTEONTX_TIM_PF
	tristate "OcteonTX TIM physical function driver(TIM_PF)"
	depends on 64BIT && OCTEONTX_RST
	default y
	help
	  Select this option to enable TIM Physical function.

config OCTEONTX_PKI
	tristate "OcteonTX Input packet parser(PKI)"
	depends on 64BIT
	default y
	help
	  Select this option to enable PKI.
          PKI parses input packets and create work.

config OCTEONTX_DPI
	tristate "OcteonTX DMA Packet Interface(DPI)"
	depends on 64BIT
	default y
	help
	  Select this option to enable DPI.
	  DPI (DMA packet interface) provides DMA support for MAC.
	  It transfers data between onchip IO bus and SLI.
	  SLI interfaces PEM(PCIe) blocks.

config OCTEONTX_ZIP_PF
	tristate "OcteonTX ZIP physical function driver(ZIP_PF)"
	depends on 64BIT
	default y
	help
	  Select this option to enable ZIP Physical function.
	  ZIP provides hardware compression/decompression support.

config OCTEONTX_SLI_PF
	tristate "OcteonTX SLI physical function driver(SLI_PF)"
	depends on 64BIT && OCTEONTX_DPI
	default y
	help
	  Select this option to enable SLI.
          SLI interfaces PEM(PCIe) blocks to the cores and memory.
          SLI needs to be configured when OcteonTX is connected
          in EP mode to a host.

config OCTEONTX
	tristate "OcteonTX coprocessor maintanier"
	depends on THUNDER_NIC_BGX && OCTEONTX_FPA_PF && OCTEONTX_SSO_PF
	depends on OCTEONTX_PKO_PF
	depends on OCTEONTX_DPI
	depends on OCTEONTX_ZIP_PF
	depends on OCTEONTX_SLI_PF
	default y
	help
	  Select this option to enable Octeon coprocessor management.

endif # NET_VENDOR_CAVIUM
```
